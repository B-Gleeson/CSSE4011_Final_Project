## embedded/m5core/final/build/Kconfig/arch/Kconfig
```kconfig
# Load Zephyr Arch Kconfig descriptions.
osource "/home/oscar/csse4011/zephyr/arch/rx/Kconfig"
osource "/home/oscar/csse4011/zephyr/arch/x86/Kconfig"
osource "/home/oscar/csse4011/zephyr/arch/xtensa/Kconfig"
osource "/home/oscar/csse4011/zephyr/arch/sparc/Kconfig"
osource "/home/oscar/csse4011/zephyr/arch/riscv/Kconfig"
osource "/home/oscar/csse4011/zephyr/arch/posix/Kconfig"
osource "/home/oscar/csse4011/zephyr/arch/mips/Kconfig"
osource "/home/oscar/csse4011/zephyr/arch/arm64/Kconfig"
osource "/home/oscar/csse4011/zephyr/arch/arm/Kconfig"
osource "/home/oscar/csse4011/zephyr/arch/arc/Kconfig"
```

## embedded/m5core/final/build/Kconfig/boards/Kconfig
```kconfig
# Load Zephyr board Kconfig descriptions.
osource "/home/oscar/csse4011/zephyr/boards/m5stack/m5stack_core2/Kconfig"
```

## embedded/m5core/final/build/Kconfig/boards/Kconfig.defconfig
```kconfig
# Load Zephyr board defconfig descriptions.
osource "/home/oscar/csse4011/zephyr/boards/m5stack/m5stack_core2/Kconfig.defconfig"
```
